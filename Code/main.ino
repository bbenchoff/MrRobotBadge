//sudo ./esptool.py  write_flash 0x00000 /tmp/arduino_build_66120/main.ino.bin
#include "RobotGFX.h"
#include "FS.h"
#include "animations.h"
#include "scrolls.h"
#include "bitmaps.h"
#include "snek.h"

#define PIN_LEFT    0
#define PIN_DOWN    16
#define PIN_RIGHT   15
#define PIN_UP      13
#define PIN_A       12
#define PIN_B       14

#define PIN_LEFT_PRESS() (digitalRead(PIN_LEFT) == LOW)
#define PIN_DOWN_PRESS() (digitalRead(PIN_DOWN) == LOW)
#define PIN_RIGHT_PRESS() (digitalRead(PIN_RIGHT) == HIGH)
#define PIN_UP_PRESS() (digitalRead(PIN_UP) == LOW)
#define PIN_A_PRESS() (digitalRead(PIN_A) == LOW)
#define PIN_B_PRESS() (digitalRead(PIN_B) == LOW)

static uint8_t USER_NAME[5400]  = {
  0x00,   0x00,   0x00,   0x00,   0x00,   0x00,   0x00,   0x00,   0x00,   0x00,   0x00,   0x00,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   0x00, 
  0x00,   0x00,   0x00,   0x00,   0x00,   0x00,   0x00,   0x00,   0x00,   0x00,   0x00,   0x00,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   0x00, 
  0x00,   0x00,   0x00,   0xFF,   0xFF,   0xFF,   0x42,   0x00,   0x00,   0x2E,   0xFF,   0xFF,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   0x00, 
  0x00,   0x00,   0x00,   0xFF,   0xFF,   0xFF,   0x71,   0x00,   0x00,   0x5C,   0xFF,   0xFF,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   0x00, 
  0x00,   0x00,   0x00,   0xFF,   0xFF,   0xE8,   0xA0,   0x00,   0x00,   0x8A,   0xE7,   0xFF,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   0x00, 
  0x00,   0x00,   0x00,   0xFF,   0xFF,   0xBC,   0xCF,   0x00,   0x00,   0xB8,   0xB9,   0xFF,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   0x00, 
  0x00,   0x00,   0x00,   0xFF,   0xFF,   0x91,   0xF9,   0x05,   0x00,   0xE5,   0x8C,   0xFF,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   0x00, 
  0x00,   0x00,   0x00,   0xFF,   0xFF,   0x65,   0xFF,   0x2D,   0x14,   0xFF,   0x5F,   0xFF,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   0x00, 
  0x00,   0x00,   0x00,   0xFF,   0xFF,   0x39,   0xFF,   0x5C,   0x41,   0xFF,   0x31,   0xFF,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   0x00, 
  0x00,   0x00,   0x00,   0xFF,   0xFF,   0x12,   0xFB,   0x8A,   0x6E,   0xFC,   0x08,   0xFF,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   0x00, 
  0x00,   0x00,   0x00,   0xFF,   0xFF,   0x0B,   0xD5,   0xB9,   0x9C,   0xD7,   0x00,   0xFF,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   0x00, 
  0x00,   0x00,   0x00,   0xFF,   0xFF,   0x0B,   0xA9,   0xE8,   0xCA,   0xA9,   0x00,   0xFF,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   0x00, 
  0x00,   0x00,   0x00,   0xFF,   0xFF,   0x0B,   0x7D,   0xFF,   0xFB,   0x7C,   0x00,   0xFF,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   0x00, 
  0x00,   0x00,   0x00,   0xFF,   0xFF,   0x0B,   0x51,   0xFF,   0xFF,   0x4F,   0x00,   0xFF,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   0x00, 
  0x00,   0x00,   0x00,   0xFF,   0xFF,   0x0B,   0x25,   0xFF,   0xFF,   0x22,   0x00,   0xFF,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   0x00, 
  0x00,   0x00,   0x00,   0x00,   0x00,   0x00,   0x00,   0x00,   0x00,   0x00,   0x00,   0x00,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   0x00, 
  0x00,   0x00,   0x00,   0x00,   0x00,   0x00,   0x00,   0x00,   0x00,   0x00,   0x00,   0x00,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   0x00, 
  0x00,   0x00,   0x00,   0x00,   0x00,   0x00,   0x00,   0x00,   0x00,   0x00,   0x00,   0x00,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   0x00,   0x00};
SideScroll USER_NAME_scroll(300,18,USER_NAME,0,false);


String USER_NAME_TAG = "nametag.txt";

enum ProgramName{ Menu,TidePod, TPCheck, Snake, Demo, Tetris, EightBall, NTEnter, NTDisp, };

struct ProgramState
  {
    ProgramName current_program; // current program running
    ProgramName current_menu; // current menu item
    bool is_menu; // is in menu mode
    int8_t current_animation;
    uint8_t anim_loop_count;
    uint8_t pod_idx;
    uint8_t current_nt;
    ProgramState(){
      current_nt = 0;
      pod_idx = 0;
      current_program = Menu;
      current_menu = Demo;
      is_menu = true;
      current_animation = 0;
      anim_loop_count = 0;
    }
  };
////

AGFXShim frame_buffer(SDA_PIN,SCL_PIN);
ProgramState state;
SnakeGame snake_game;


void writeScrollToSpiff(String fname, SideScroll& ss)
{ // this is shitty and simple. It assumes a fixed size buffer and just writes. 
  SPIFFS.begin();
  File f = SPIFFS.open("/nametag.txt", "w");
  uint16_t sz = ss.w*ss.h;
  f.write((byte*)ss.pixel_buffer, sz);
  f.close();    
  SPIFFS.end();

}

void readSpiffToScroll(String fname, SideScroll& ss)
{ // this is shitty and simple. It assumes a fixed size buffer and just writes. 
  
  SPIFFS.begin();
  File f = SPIFFS.open("/nametag.txt", "r");
  uint16_t sz = ss.w*ss.h;
  f.read((byte*)ss.pixel_buffer,sz);
  f.close();
  SPIFFS.end();

}


void init_spiffs(void)
{
  SPIFFS.begin();
  if(!SPIFFS.exists("/pods.txt") ){       
      SPIFFS.format();
      byte empty[256];
      memset(empty,0x00,256);
      File f = SPIFFS.open("/pods.txt", "w");
      f.write(empty, 256);
      f.close(); 
  }
  if( !SPIFFS.exists("/nametag.txt")){ 
    File nt = SPIFFS.open("nametag.txt", "w");
    uint16_t sz = USER_NAME_scroll.w * USER_NAME_scroll.h;
    nt.write(USER_NAME_scroll.pixel_buffer, sz);
    nt.close(); 
  } 
}

bool any_key(void)
{
  bool retVal = false;
  if ( PIN_UP_PRESS()   || PIN_DOWN_PRESS()  || 
       PIN_LEFT_PRESS() || PIN_RIGHT_PRESS() ||
       PIN_A_PRESS()    || PIN_B_PRESS() ){
        retVal = true;
    }
  return retVal;
}

bool ab_key(void)
{
  bool retVal = false;
  if( PIN_A_PRESS()    || PIN_B_PRESS() ){
        retVal = true;
        delay(100);
    }
  return retVal;
}

void reset_scrolls(void)
{
  ANYKEY_scroll.x=0;
  BLEACH_scroll.x=0;
  BLOCKCHAIN_scroll.x=0;
  BUTT_scroll.x=0;
  COLLECTED_scroll.x=0;
  DEMO_scroll.x=0;
  DIRECTIONS_scroll.x=0;
  DISPTAG_scroll.x=0;
  DRINK_scroll.x=0;
  EATED_scroll.x=0;
  HASHID_scroll.x=0;
  HOPE_scroll.x=0;
  INVADERS_scroll.x=0;
  MAGIC_scroll.x=0;
  MAGIC8_scroll.x=0;
  NO_scroll.x=0;
  NOALPHA_scroll.x=0;
  ROBOT_scroll.x=0;
  SETTAG_scroll.x=0;
  SHRUG_scroll.x=0;
  SNEK_scroll.x=0;
  SUPREME_scroll.x=0;
  TETRIS_scroll.x=0;
  TIDE_scroll.x=0;
  VIEWTIDE_scroll.x=0;
  YES_scroll.x=0;
}

void check_break(){
  if( PIN_DOWN_PRESS() && PIN_A_PRESS() && PIN_B_PRESS() ){
    state.current_menu = Demo;
    state.current_program = Menu;
    state.is_menu = true;
    reset_scrolls();
    delay(200);
  }

}

void clear_screen(void){
  frame_buffer.fillScreen(0);
  frame_buffer.execute();
  delay(50);
}

bool blit(Bitmap& bm, SideScroll& ss, uint16_t xoff, uint16_t yoff )
{
  // Copy over data from progmem in a bitmap to a 
  // side scroll object. 
  if( bm.w + xoff > ss.w || bm.h + yoff > ss.h )
  { // won't fit. Error out. 
    return false; 
  }
  uint16_t x,y,bm_idx,ss_idx,tx,ty;
  uint8_t bm_val;
  for( y = 0; y < bm.h; y++){
    for( x = 0; x < bm.w; x++){
      tx = x+xoff;
      ty = y+yoff;
      bm_idx = x + (y*bm.w);
      ss_idx = tx + (ty*ss.w);
      bm_val = (uint8_t) pgm_read_byte_near(bm.pixel_buffer+bm_idx);
      ss.pixel_buffer[ss_idx] = bm_val; 
    }
  }
  return true;
}


void setup() {
  init_spiffs();
  
  frame_buffer.init();
  frame_buffer.setAutoClear(true);
  frame_buffer.setTextSize(1);
  frame_buffer.setTextWrap(false);
  frame_buffer.setTextColor(255);
  frame_buffer.setRotation(3);
  
  pinMode(PIN_LEFT, INPUT_PULLUP);
  pinMode(PIN_DOWN, INPUT_PULLUP);
  pinMode(PIN_RIGHT, INPUT);
  pinMode(PIN_UP, INPUT_PULLUP);
  pinMode(PIN_A, INPUT_PULLUP);
  pinMode(PIN_B, INPUT_PULLUP);
  
  ASPLODE_animation.invert = true;
  BREATHE_animation.invert = true;
  CUBE_animation.invert = true;
  CUBE2_animation.invert = true;
  HEART_animation.invert = true;
  INTERFERENCE_animation.invert = true;
  TRIANGLE_animation.invert = true,
  MOVEW_animation.invert = true;
  SPACE_animation.speed = 200;
  TRIANGLE_animation.invert = true;
  WALK_animation.invert = true;

  knight_rider();
  while( !frame_buffer.animate_sidescroll(&ROBOT_scroll) ){
    frame_buffer.execute();
    delay(ROBOT_scroll.speed);
    if( ab_key() )
    {  while( !frame_buffer.animate_sidescroll(&ROBOT_scroll) ){
    frame_buffer.execute();
    delay(ROBOT_scroll.speed);
    if( ab_key() )
    {
      delay(100);
      break;
    }
  }

      delay(100);
      break;
    }
  }
}

void knight_rider()
{
  uint16_t v = 255;
  uint8_t l = 1;
  uint8_t s = 0;
  uint8_t d = 20;
  uint8_t k = 0;
  uint8_t w = 17;
  uint8_t c = 3;
  for( c = 0; c < 3; c++ ){
    for( k = 0; k < 18; k++){
      frame_buffer.startWrite();
      frame_buffer.writeFastHLine(0,k,18,v);
      frame_buffer.writeFastHLine(0,w-k,18,v);
      if( k > 0 ){
        frame_buffer.writeFastHLine(0,k-1,18,v/4);
        frame_buffer.writeFastHLine(0,w-k+1,18,v/4);
      }
      if( k > 1 ){
        frame_buffer.writeFastHLine(0,k-2,18,v/16);
        frame_buffer.writeFastHLine(0,w-k+2,18,v/16);
      }
      frame_buffer.execute();
    }
    delay(d);
  }
  for( c = 0; c < 3; c++ ){
    for( k = 0; k < 18; k++){
      frame_buffer.startWrite();
      frame_buffer.writeFastVLine(k,0,18,v);
      frame_buffer.writeFastVLine(w-k,0,18,v);
      if( k > 0 ){
        frame_buffer.writeFastVLine(k-1,0,18,v/4);
        frame_buffer.writeFastVLine(w-k+1,0,18,v/4);
      }
      if( k > 1 ){
        frame_buffer.writeFastVLine(k-2,0,18,v/16);
        frame_buffer.writeFastVLine(w-k+2,0,18,v/16);
      }
      frame_buffer.execute();
    }
    delay(d);
  }
  v = 128;
  for( c = 0; c < 3; c++ ){
    for( k = 0; k < 18; k++){
      frame_buffer.startWrite();
      frame_buffer.writeFastHLine(0,k,18,v);
      frame_buffer.writeFastHLine(0,w-k,18,v);
      frame_buffer.writeFastVLine(k,0,18,v);
      frame_buffer.writeFastVLine(w-k,0,18,v);
      if( k > 0 ){
        frame_buffer.writeFastHLine(0,k-1,18,v/4);
        frame_buffer.writeFastHLine(0,w-k+1,18,v/4);
        frame_buffer.writeFastVLine(k-1,0,18,v/4);
        frame_buffer.writeFastVLine(w-k+1,0,18,v/4);
      }
      frame_buffer.execute();
    }
    delay(d);
  }
}
void bubbles()
{
  uint16_t x,y;
  uint16_t c,r,i,j;
  for( i = 0; i < 5; i++ ){
    for( j = 0; j < 324; j++){
      x = random(0,18);
      y = random(0,18);
      c = random(0,255);
      frame_buffer.writePixel(x,y,c);
    } 
    frame_buffer.execute();
    delay(20);
  }

}

void run_animate(ProgramState& ps)
{
  bool result = false;
  result = frame_buffer.run_animation(ANIMATION_LIST[ps.current_animation]);
  frame_buffer.execute();
  delay(ANIMATION_LIST[ps.current_animation]->speed);
  if( result )
  {
    ps.anim_loop_count++;
  }
  if( ps.anim_loop_count >= 3 ){
    ps.current_animation++;
    ps.anim_loop_count = 0;
    if( ps.current_animation >= total_animations ){
      ps.current_animation = 0;
    }
  }
  else if( PIN_A_PRESS() )
  {
    ps.current_animation++;
    ps.anim_loop_count = 0;
    if( ps.current_animation >= total_animations ){
      ps.current_animation = 0;
    }
    delay(200);
  }
  else if( PIN_B_PRESS() )
  {
    ps.current_animation--;
    ps.anim_loop_count = 0;
    if( ps.current_animation <= 0 ){
      ps.current_animation =  total_animations-1;
    }
    delay(200);
  }
  
}

void not_implemented_error(ProgramState& ps)
{
    frame_buffer.animate_sidescroll(&NOALPHA_scroll);
    frame_buffer.execute();
    delay(ANYKEY_scroll.speed);
}
void returnToMenu( ProgramState& ps)
{
  ps.current_menu = Demo;
  ps.current_program = Menu;
  ps.is_menu = true;
  reset_scrolls();
}


void snek(ProgramState& ps )
{
  uint16_t x,y,idx;
    snake_game.updateDirection(PIN_UP_PRESS(),PIN_DOWN_PRESS(),PIN_LEFT_PRESS(),PIN_RIGHT_PRESS());
    snake_game.moveSnake();
    for(y=0;y<18;y++){
      for(x=0;x<18;x++){
        frame_buffer.drawPixel(x,y, 50*snake_game.snakeBoard[y][x]);
      }
    }
    frame_buffer.execute( );
    delay(80);
    if( !snake_game.gameRunning )
    {
      returnToMenu(ps);
    }
}

void displayTidePods(ProgramState& ps)
{
  uint16_t c=0;
  byte empty[256];
  uint8_t x,y,idx,i,count;
  byte pod[128];
  char out[3];
  
  for( i = 0; i < 8; i++ ){
    while(!frame_buffer.run_animation(&SPINNER_animation)){
    frame_buffer.execute();
    delay(150);
  }}
  SPIFFS.begin();
  File f = SPIFFS.open("/pods.txt", "r");
  f.read(empty,256);
  f.close();
  SPIFFS.end();

  count = 0;
  for( i = 0; i < 255; i++ )
  {
    if( empty[i] > 0x00 ){
      count = count + 1;
    }
  }

  clear_screen();

  for( i = 0; i < 1; i++ ){
    while(!frame_buffer.animate_sidescroll(&COLLECTED_scroll)){
    frame_buffer.execute();
    delay(50);
  }}

  clear_screen();

  itoa(count,out,10);
  frame_buffer.setCursor(0,6);
  frame_buffer.print(out);
  frame_buffer.execute();
  delay(2000);

  clear_screen();

  for( i = 0; i < 1; i++ ){
    while(!frame_buffer.animate_sidescroll(&HASHID_scroll)){
    frame_buffer.execute();
    delay(50);
  }}

  clear_screen();

  for( x = 1; x < 17; x++ ){
    for( y = 1; y < 17; y++ ){
      idx = x + y*16;
      frame_buffer.writePixel(x,y,(uint16_t)empty[idx]);              
    }}
  frame_buffer.execute();
  delay(1000);  
  
}

void do_an_eight_ball(ProgramState& ps)
{
  uint8_t i = 0;
  for( i=0; i < 5; i++ ){
    ab_key();
    delay(1);
  }

  for( i = 0; i < 1; i++ ){
    while(!frame_buffer.animate_sidescroll(&MAGIC8_scroll)){
    frame_buffer.execute();
    delay(30);
    if( ab_key )
    {
      break;
    }
  }}

 for( i=0; i < 5; i++ ){
    ab_key();
    delay(1);
  }
  
  while( !ab_key() )
  {
    frame_buffer.animate_sidescroll(&MAGIC8_scroll);
    frame_buffer.execute();
    delay(30);
  }

  for( i=0; i < 128; i++ )
  {
    EIGHTBALL_bitmap.x = random(3);
    EIGHTBALL_bitmap.y = random(3);
    frame_buffer.fillScreen(255);
    frame_buffer.drawBitmap(&EIGHTBALL_bitmap);
    frame_buffer.execute();
    delay(20);
  }

  uint8_t count = 7;
  uint8_t answer = (uint8_t)random(0,7);
  SideScroll* answers[7];
  answers[0] = &YES_scroll;
  answers[1] = &NO_scroll;
  answers[2] = &DRINK_scroll;
  answers[3] = &BUTT_scroll;
  answers[4] = &SHRUG_scroll;
  answers[5] = &BLEACH_scroll;
  answers[6] = &BLOCKCHAIN_scroll;
  

  for( i = 0; i <  2; i++ ){
    while(!frame_buffer.animate_sidescroll(answers[answer])){
    frame_buffer.execute();
    delay(50);
  }}
  
}

void updateTidePods(ProgramState& ps )
{
  uint16_t c=0;
  byte empty[256];
  uint8_t x,y,idx,i,count;
  byte pod[128];
  char out[3];
  for(c =0; c < 256; c++){
    empty[c] = 0x00;
  }
  ANYKEY_scroll.x = 0;
  
  for( i=0; i < 5; i++ ){
    ab_key();
  }

  for( i = 0; i < 1; i++ ){
    while(!frame_buffer.animate_sidescroll(&ANYKEY_scroll)){
    frame_buffer.execute();
    delay(50);
  }}
  
  while( !ab_key() )
  {
    frame_buffer.animate_sidescroll(&ANYKEY_scroll);
    frame_buffer.execute();
    delay(50);
  }

  for( i = 0; i < 5; i++ ){
    while(!frame_buffer.run_animation(&GULP_animation)){
    frame_buffer.execute();
    delay(100);
  }}
  
  for( i = 0; i < 5; i++ ){
    while(!frame_buffer.run_animation(&SPINNER_animation)){
    frame_buffer.execute();
    delay(100);
  }}

//  byte error;    
//  Wire.begin(0x50);  
//  Wire.beginTransmission(0x50);
//  delay(10);
//  error = Wire.endTransmission();
//  if( error != 0x00 ){
//    returnToMenu(ps);
//    return;
//  }
  // do the read 
//  brzo_i2c_start_transaction(0x50, 400); 
//  uint8_t b[2];
//  b[0]= 0x00;
//  b[1]= 0x00;
//  brzo_i2c_write(b, 2, false); // Dump the page 0 buffer
//  brzo_i2c_ACK_polling(1);
//  if( brzo_i2c_end_transaction() > 0 )
//  {
//    returnToMenu(ps);
//    return;
//  }

  brzo_i2c_start_transaction(0x50, 400); // open I2C to EEPROM at 400kHz
  uint8_t buff[2];
  buff[0]= 0x00;
  buff[1]= 0x00;
  brzo_i2c_write(buff, 2, false); // Dump the page 0 buffer
  brzo_i2c_read(pod, 128, false); // Dump the page 0 buffer
  brzo_i2c_end_transaction();
  uint8_t pod_num = (uint8_t)pod[0];
  SPIFFS.begin();
  File f = SPIFFS.open("/pods.txt", "r");
  f.read(empty,256);
  f.close();

  empty[pod_num] = 0xFF;
  ps.pod_idx++;
  f = SPIFFS.open("/pods.txt", "w");
  f.write(empty, 256);
  f.close();    
  SPIFFS.end();
  
  count = 0;
  for( i = 0; i < 255; i++ )
  {
    if( empty[i] > 0x00 ){
      count = count + 1;
    }
  }

  for( i = 0; i < 1; i++ ){
    while(!frame_buffer.animate_sidescroll(&EATED_scroll)){
    frame_buffer.execute();
    delay(50);
  }}

  clear_screen();
  
  itoa(pod_num,out,10);
  frame_buffer.setCursor(0,6);
  frame_buffer.print(out);
  frame_buffer.execute();
  delay(2000);

  clear_screen();

  for( i = 0; i < 1; i++ ){
    while(!frame_buffer.animate_sidescroll(&COLLECTED_scroll)){
    frame_buffer.execute();
    delay(50);
  }}

  clear_screen();

  itoa(count,out,10);
  frame_buffer.setCursor(0,6);
  frame_buffer.print(out);
  frame_buffer.execute();
  delay(2000);

  clear_screen();

  for( i = 0; i < 1; i++ ){
    while(!frame_buffer.animate_sidescroll(&HASHID_scroll)){
    frame_buffer.execute();
    delay(50);
  }}

  clear_screen();

  for( x = 1; x < 17; x++ ){
    for( y = 1; y < 17; y++ ){
      idx = x + y*16;
      frame_buffer.writePixel(x,y,(uint16_t)empty[idx]);              
    }}
  frame_buffer.execute();
  delay(1000);    
}

void display_name_tag(ProgramState& ps)
{
  bool result = false;
  SideScroll* to_show[5];
  to_show[0] = &USER_NAME_scroll;
  to_show[1] = &ROBOT_scroll;
  to_show[2] = &SUPREME_scroll;
  to_show[3] = &SHRUG_scroll;
  to_show[4] = &HOPE_scroll;
  if( ps.current_nt == 0 ){
    result = frame_buffer.animate_sidescroll_h_local(to_show[ps.current_nt]);
    frame_buffer.execute();
    delay(50);
  }else{
    result = frame_buffer.animate_sidescroll(to_show[ps.current_nt]);
    frame_buffer.execute();
    delay(50);    
  }
  
  if( result )
  {
    ps.current_nt++;
  }
  if( ps.current_nt > 4 ){
    ps.current_nt = 0;
  }
  
}

void edit_name_tag(ProgramState& ps)
{
  int8_t current_bitmap = 0;
  uint8_t i;
  uint16_t current_x = 0;
  bool done = false;
  uint16_t sz = USER_NAME_scroll.w*USER_NAME_scroll.h;
  memset(USER_NAME_scroll.pixel_buffer,0x00,sz);
  // give the user some directions 
  while( !frame_buffer.animate_sidescroll(&DIRECTIONS_scroll) ){
    frame_buffer.execute();
    delay(10);
  }
  DIRECTIONS_scroll.x = 0;
  
  while(!done)
  {
    BITMAP_LIST[current_bitmap]->x = 0;
    BITMAP_LIST[current_bitmap]->y = 0;
    frame_buffer.drawBitmap(BITMAP_LIST[current_bitmap]);
    frame_buffer.execute();
    delay(40);
    if( PIN_UP_PRESS() ){
      current_bitmap++;
      if( current_bitmap >= total_bitmaps ){
        current_bitmap = 0;
      }
      delay(150);
    }
    else if( PIN_DOWN_PRESS() ){
      current_bitmap--;
      if( current_bitmap <= 0){
        current_bitmap = total_bitmaps-1;
      }
      delay(150);
    }
    else if( PIN_B_PRESS() ){
      for( i = 0; i < 8; i++ )
      {        
        BITMAP_LIST[current_bitmap]->invert = (bool)(i%2);
        frame_buffer.drawBitmap(BITMAP_LIST[current_bitmap]);
        frame_buffer.execute();
        delay(30);
      }
      BITMAP_LIST[current_bitmap]->invert = false;
      blit(*BITMAP_LIST[current_bitmap], USER_NAME_scroll, current_x, 0 );
      current_x += BITMAP_LIST[current_bitmap]->w;
      current_bitmap = 0;
    }
    else if( PIN_A_PRESS() && PIN_LEFT_PRESS() ){
     done = true;  
     delay(100);
    }
    else if( PIN_A_PRESS() && PIN_RIGHT_PRESS() ){
     while(!frame_buffer.animate_sidescroll(&USER_NAME_scroll)){
      frame_buffer.execute();
      delay(10);}
    }
  }
  returnToMenu(ps);
  writeScrollToSpiff("./nametag.txt", USER_NAME_scroll);  
  delay(200);
  return;
}

void loop() {
  if( state.is_menu){
    //enum ProgramName{ Menu,TidePod, TPCheck, Snake, Demo, Tetris, EightBall, NTEnter, NTDisp, };
    switch(state.current_menu){
      case Menu:
        state.current_menu = (enum ProgramName)(((int)state.current_menu) + 1) ;
        break;
      case TidePod:
        frame_buffer.animate_sidescroll(&TIDE_scroll);
        frame_buffer.execute();
        delay(TIDE_scroll.speed);
        break;
      case TPCheck:
        frame_buffer.animate_sidescroll(&VIEWTIDE_scroll);
        frame_buffer.execute();
        delay(VIEWTIDE_scroll.speed);  
        break;        
      case Snake:
        frame_buffer.animate_sidescroll(&SNEK_scroll);
        frame_buffer.execute();
        delay(SNEK_scroll.speed);
        break;        
      case Demo:
        frame_buffer.animate_sidescroll(&DEMO_scroll);
        frame_buffer.execute();
        delay(DEMO_scroll.speed);
        break;
      case Tetris:
        frame_buffer.animate_sidescroll(&TETRIS_scroll);
        frame_buffer.execute();
        delay(TETRIS_scroll.speed);
        break;
      case EightBall:
        frame_buffer.animate_sidescroll(&MAGIC_scroll);
        frame_buffer.execute();
        delay(MAGIC_scroll.speed);
        break;
      case NTEnter:
        frame_buffer.animate_sidescroll(&SETTAG_scroll);
        frame_buffer.execute();
        delay(SETTAG_scroll.speed);
        break;
      case NTDisp:
        frame_buffer.animate_sidescroll(&DISPTAG_scroll);
        frame_buffer.execute();
        delay(DISPTAG_scroll.speed);
        break;
        
    }// end switch
    if( PIN_A_PRESS() || PIN_B_PRESS() ){
      state.current_program = state.current_menu;
      state.is_menu = false;
      if( state.current_program == Snake ){
        snake_game.init();
        snake_game.gameRunning = true;
      }
      else if( state.current_program == NTDisp )
      {
        readSpiffToScroll("nametag.txt", USER_NAME_scroll);
        reset_scrolls();
      }
      else if( state.current_program == TidePod )
      {
          byte empty[256];
          uint16_t i;
          for( i=0; i<256; i++)
          {
            empty[i] = 0x00;
          }
          SPIFFS.begin();
          if(!SPIFFS.exists("/pods.txt")){
            File f = SPIFFS.open("/pods.txt", "w");
            f.write(empty, 256);
            f.close(); 
          }
          SPIFFS.end();
      }
      
    }

    if( PIN_DOWN_PRESS() ){
       if( state.current_menu == Menu ){
          state.current_menu = TidePod;
        }
        else if( state.current_menu == TidePod ){
          state.current_menu = TPCheck;
        }
        else if( state.current_menu == TPCheck ){
          state.current_menu = Snake;
        }
        else if( state.current_menu == Snake ){
          state.current_menu = Demo;
        }
        else if( state.current_menu == Demo ){
          state.current_menu = Tetris;
        }
        else if( state.current_menu == Tetris ){
          state.current_menu = EightBall;
        }        
        else if( state.current_menu == EightBall ){
          state.current_menu = NTEnter;
        }        
        else if( state.current_menu == NTEnter ){
          state.current_menu = NTDisp;
        }        
        else if( state.current_menu == NTDisp ){
          state.current_menu = TidePod;
        }                        
        delay(200);
    }
    if( PIN_UP_PRESS() ){
       // enum ProgramName{ Menu,TidePod, TPCheck, Snake, Demo, Tetris, EightBall, NTEnter, NTDisp, };
        if( state.current_menu == Menu ){
          state.current_menu = TidePod;
        }
        else if( state.current_menu == TidePod ){
          state.current_menu = NTDisp;
        }
        else if( state.current_menu == NTDisp ){
          state.current_menu = NTEnter;
        }
        else if( state.current_menu == NTEnter ){
          state.current_menu = EightBall;
        }
        else if( state.current_menu == EightBall ){
          state.current_menu = Tetris;
        }
        else if( state.current_menu == Tetris ){
          state.current_menu = Demo;
        }        
        else if( state.current_menu == Demo ){
          state.current_menu = Snake;
        }        
        else if( state.current_menu == Snake ){
          state.current_menu = TPCheck;
        }        
        else if( state.current_menu == TPCheck ){
          state.current_menu = TidePod;
        }                        
        delay(200);
    }
  }else
  {
    // enum ProgramName{ Menu,TidePod, TPCheck, Snake, Demo, Tetris, EightBall, NTEnter, NTDisp, };
    switch(state.current_program){
      case Menu:
        state.current_menu = (enum ProgramName)(((int)state.current_menu) + 1) ;
        break;
      case TidePod:
        updateTidePods(state);
        returnToMenu(state);
        break;
      case TPCheck:
        displayTidePods(state);
        returnToMenu(state);
      case Snake:
        snek(state);
        break;        
      case Demo:
        run_animate(state);
        break;
      case Tetris:
        not_implemented_error(state);
        break;
      case EightBall:
        do_an_eight_ball(state);
        returnToMenu(state);
        break;
      case NTEnter:
        edit_name_tag(state);
        break;
      case NTDisp:
        display_name_tag(state);
        break;
    } // end switch
  }
  check_break();
}

//static uint8_t LED_LUT[324] = {
//
//0x11, 0x2F, 0x4D, 0x6B, 0x89, 0xA7, 0x11, 0x2F, 0x4D, 0x12, 0x30, 0x4E, 0x6C, 0x8A, 0xA8, 0x12, 0x30, 0x4E,
//0x10, 0x2E, 0x4C, 0x6A, 0x88, 0xA6, 0x10, 0x2E, 0x4C, 0x13, 0x31, 0x4F, 0x6D, 0x8B, 0xA9, 0x13, 0x31, 0x4F,
//0x0F, 0x2D, 0x4B, 0x69, 0x87, 0xA5, 0x0F, 0x2D, 0x4B, 0x14, 0x32, 0x50, 0x6E, 0x8C, 0xAA, 0x14, 0x32, 0x50,
//0x0E, 0x2C, 0x4A, 0x68, 0x86, 0xA4, 0x0E, 0x2C, 0x4A, 0x15, 0x33, 0x51, 0x6F, 0x8D, 0xAB, 0x15, 0x33, 0x51,
//0x0D, 0x2B, 0x49, 0x67, 0x85, 0xA3, 0x0D, 0x2B, 0x49, 0x16, 0x34, 0x52, 0x70, 0x8E, 0xAC, 0x16, 0x34, 0x52,
//0x0C, 0x2A, 0x48, 0x66, 0x84, 0xA2, 0x0C, 0x2A, 0x48, 0x17, 0x35, 0x53, 0x71, 0x8F, 0xAD, 0x17, 0x35, 0x53,
//0x0B, 0x29, 0x47, 0x65, 0x83, 0xA1, 0x0B, 0x29, 0x47, 0x18, 0x36, 0x54, 0x72, 0x90, 0xAE, 0x18, 0x36, 0x54,
//0x0A, 0x28, 0x46, 0x64, 0x82, 0xA0, 0x0A, 0x28, 0x46, 0x19, 0x37, 0x55, 0x73, 0x91, 0xAF, 0x19, 0x37, 0x55,
//0x09, 0x27, 0x45, 0x63, 0x81, 0x9F, 0x09, 0x27, 0x45, 0x1A, 0x38, 0x56, 0x74, 0x92, 0xB0, 0x1A, 0x38, 0x56,
//0x08, 0x26, 0x44, 0x62, 0x80, 0x9E, 0x08, 0x26, 0x44, 0x1B, 0x39, 0x57, 0x75, 0x93, 0xB1, 0x1B, 0x39, 0x57,
//0x07, 0x25, 0x43, 0x61, 0x7F, 0x9D, 0x07, 0x25, 0x43, 0x1C, 0x3A, 0x58, 0x76, 0x94, 0xB2, 0x1C, 0x3A, 0x58,
//0x06, 0x24, 0x42, 0x60, 0x7E, 0x9C, 0x06, 0x24, 0x42, 0x1D, 0x3B, 0x59, 0x77, 0x95, 0xB3, 0x1D, 0x3B, 0x59,
//0x05, 0x23, 0x41, 0x5F, 0x7D, 0x9B, 0x05, 0x23, 0x41, 0x5A, 0x63, 0x6C, 0x75, 0x7E, 0x87, 0x90, 0x99, 0xA2,
//0x04, 0x22, 0x40, 0x5E, 0x7C, 0x9A, 0x04, 0x22, 0x40, 0x5B, 0x64, 0x6D, 0x76, 0x7F, 0x88, 0x91, 0x9A, 0xA3,
//0x03, 0x21, 0x3F, 0x5D, 0x7B, 0x99, 0x03, 0x21, 0x3F, 0x5C, 0x65, 0x6E, 0x77, 0x80, 0x89, 0x92, 0x9B, 0xA4,
//0x02, 0x20, 0x3E, 0x5C, 0x7A, 0x98, 0x02, 0x20, 0x3E, 0x5D, 0x66, 0x6F, 0x78, 0x81, 0x8A, 0x93, 0x9C, 0xA5,
//0x01, 0x1F, 0x3D, 0x5B, 0x79, 0x97, 0x01, 0x1F, 0x3D, 0x5E, 0x67, 0x70, 0x79, 0x82, 0x8B, 0x94, 0x9D, 0xA6,
//0x00, 0x1E, 0x3C, 0x5A, 0x78, 0x96, 0x00, 0x1E, 0x3C, 0x5F, 0x68, 0x71, 0x7A, 0x83, 0x8C, 0x95, 0x9E, 0xA7};
//
//static uint8_t PAGE_LUT[324] = {
//  0x00, 0x00, 0x00, 0x00, 0x00, 0x00, 0x01, 0x01, 0x01, 0x00, 0x00, 0x00, 0x00, 0x00, 0x00, 0x01, 0x01, 0x01,
//  0x00, 0x00, 0x00, 0x00, 0x00, 0x00, 0x01, 0x01, 0x01, 0x00, 0x00, 0x00, 0x00, 0x00, 0x00, 0x01, 0x01, 0x01,
//  0x00, 0x00, 0x00, 0x00, 0x00, 0x00, 0x01, 0x01, 0x01, 0x00, 0x00, 0x00, 0x00, 0x00, 0x00, 0x01, 0x01, 0x01,
//  0x00, 0x00, 0x00, 0x00, 0x00, 0x00, 0x01, 0x01, 0x01, 0x00, 0x00, 0x00, 0x00, 0x00, 0x00, 0x01, 0x01, 0x01,
//  0x00, 0x00, 0x00, 0x00, 0x00, 0x00, 0x01, 0x01, 0x01, 0x00, 0x00, 0x00, 0x00, 0x00, 0x00, 0x01, 0x01, 0x01,
//  0x00, 0x00, 0x00, 0x00, 0x00, 0x00, 0x01, 0x01, 0x01, 0x00, 0x00, 0x00, 0x00, 0x00, 0x00, 0x01, 0x01, 0x01,
//  0x00, 0x00, 0x00, 0x00, 0x00, 0x00, 0x01, 0x01, 0x01, 0x00, 0x00, 0x00, 0x00, 0x00, 0x00, 0x01, 0x01, 0x01,
//  0x00, 0x00, 0x00, 0x00, 0x00, 0x00, 0x01, 0x01, 0x01, 0x00, 0x00, 0x00, 0x00, 0x00, 0x00, 0x01, 0x01, 0x01,
//  0x00, 0x00, 0x00, 0x00, 0x00, 0x00, 0x01, 0x01, 0x01, 0x00, 0x00, 0x00, 0x00, 0x00, 0x00, 0x01, 0x01, 0x01,
//  0x00, 0x00, 0x00, 0x00, 0x00, 0x00, 0x01, 0x01, 0x01, 0x00, 0x00, 0x00, 0x00, 0x00, 0x00, 0x01, 0x01, 0x01,
//  0x00, 0x00, 0x00, 0x00, 0x00, 0x00, 0x01, 0x01, 0x01, 0x00, 0x00, 0x00, 0x00, 0x00, 0x00, 0x01, 0x01, 0x01,
//  0x00, 0x00, 0x00, 0x00, 0x00, 0x00, 0x01, 0x01, 0x01, 0x00, 0x00, 0x00, 0x00, 0x00, 0x00, 0x01, 0x01, 0x01,
//  0x00, 0x00, 0x00, 0x00, 0x00, 0x00, 0x01, 0x01, 0x01, 0x01, 0x01, 0x01, 0x01, 0x01, 0x01, 0x01, 0x01, 0x01,
//  0x00, 0x00, 0x00, 0x00, 0x00, 0x00, 0x01, 0x01, 0x01, 0x01, 0x01, 0x01, 0x01, 0x01, 0x01, 0x01, 0x01, 0x01,
//  0x00, 0x00, 0x00, 0x00, 0x00, 0x00, 0x01, 0x01, 0x01, 0x01, 0x01, 0x01, 0x01, 0x01, 0x01, 0x01, 0x01, 0x01,
//  0x00, 0x00, 0x00, 0x00, 0x00, 0x00, 0x01, 0x01, 0x01, 0x01, 0x01, 0x01, 0x01, 0x01, 0x01, 0x01, 0x01, 0x01,
//  0x00, 0x00, 0x00, 0x00, 0x00, 0x00, 0x01, 0x01, 0x01, 0x01, 0x01, 0x01, 0x01, 0x01, 0x01, 0x01, 0x01, 0x01,
//  0x00, 0x00, 0x00, 0x00, 0x00, 0x00, 0x01, 0x01, 0x01, 0x01, 0x01, 0x01, 0x01, 0x01, 0x01, 0x01, 0x01, 0x01};
//
//
//void button_test()
//{
//  frame_buffer.setAutoClear(false);
//  if( PIN_LEFT_PRESS() ){
//    frame_buffer.fillRect(0,3,3,3,128);
//  }else{
//    frame_buffer.fillRect(0,3,3,3,0);
//  }
//  if( PIN_DOWN_PRESS() ){
//     frame_buffer.fillRect(3,6,3,3,128);
//  }
//  else{
//    frame_buffer.fillRect(3,6,3,3,0);
//  }
//  if( PIN_RIGHT_PRESS() ){
//    frame_buffer.fillRect(6,3,3,3,128);
//  }
//  else{
//    frame_buffer.fillRect(6,3,3,3,0);
//  }
//  if( PIN_UP_PRESS() ){
//     frame_buffer.fillRect(3,0,3,3,128);
//  }
//  else{
//    frame_buffer.fillRect(3,0,3,3,0);
//  }
//  if ( PIN_A_PRESS() ){
//    frame_buffer.fillRect(11,3,3,3,128);
//  }
//  else{
//    frame_buffer.fillRect(11,3,3,3,0);
//  }
//
//  if( PIN_B_PRESS() )
//  {
//    frame_buffer.fillRect(15,3,3,3,128);
//  }
//  else{
//    frame_buffer.fillRect(15,3,3,3,0);
//  }
//
//  frame_buffer.drawRect(0,3,9,3,32);
//  frame_buffer.drawRect(3,0,3,9,32);
//  frame_buffer.drawRect(11,3,3,3,32);
//  frame_buffer.drawRect(15,3,3,3,32);
//}
//
//void test_text()
//{
//  String text = "MR ROBOT BADGE";
//    for (int offset=0; offset < text.length(); offset++) {
//      frame_buffer.setCursor(0,0);
//      frame_buffer.print(text.charAt(offset));
//      frame_buffer.execute();
//      delay(200);
//    }
// frame_buffer.setAutoClear(true);
//}
//void clear_spiff(void)
//{
//  uint16_t c=0;
//  byte empty[256];
//  for(c =0; c < 256; c++){
//    empty[c] = 0x00;
//  }
//
//    SPIFFS.begin();
//    SPIFFS.format();
//    File f = SPIFFS.open("/pods.txt", "w");
//    f.write(empty, 256);
//    f.close(); 
//
//}


